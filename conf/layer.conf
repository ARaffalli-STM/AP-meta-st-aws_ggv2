## conf/layer.conf
```bitbake
# We have a conf and classes directory, add to BBPATH
BBPATH .= ":${LAYERDIR}"

# We have recipes-* directories, add to BBFILES
BBFILES += "${LAYERDIR}/recipes-*/*/*.bb \
            ${LAYERDIR}/recipes-*/*/*.bbappend"

BBFILE_COLLECTIONS += "AP-meta-st-aws_ggv2"
BBFILE_PATTERN_AP-meta-st-aws_ggv2 = "^${LAYERDIR}/"
BBFILE_PRIORITY_AP-meta-st-aws_ggv2 = "7"

EULA_FILE_ST_AP-meta-st-aws_ggv2 = "${LAYERDIR}/conf/eula/${MACHINE}"
EULA_FILE_ST_MD5SUM_AP-meta-st-aws_ggv2 = "8b505090fb679839cefbcc784afe8ce9"

# Set a variable to get the STM32MP MX BSP location
STM32MP_MY_WORKSHOP_BASE = "${LAYERDIR}"

# This should only be incremented on significant changes that may
# cause compatibility issues with other layers
LAYERVERSION_AP-meta-st-aws_ggv2 = "1"

LAYERDEPENDS_AP-meta-st-aws_ggv2 = "stm-st-stm32mp-mx"


LAYERDEPENDS_AP-meta-st-aws_ggv2 = "core"
LAYERSERIES_COMPAT_AP-meta-st-aws_ggv2 = "dunfell"
```
